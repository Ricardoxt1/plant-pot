#include <WiFi.h>
#include <HTTPClient.h>
#include <DHT.h>
#include <Wire.h>
#include <Adafruit_GFX.h>
#include <Adafruit_SSD1306.h>

// Defina suas credenciais Wi-Fi
const char* ssid = "";      // Coloque o nome da sua rede Wi-Fi
const char* password = ""; // Coloque a senha da sua rede Wi-Fi

// Defina o canal e a API de escrita do ThingSpeak
const char* server = "http://api.thingspeak.com";
const char* writeAPIKey = ""; // Sua Write API Key

// Definições do DHT11
#define DHTPIN 13           // GPIO 13 onde o sensor DHT11 está conectado
#define DHTTYPE DHT11
DHT dht(DHTPIN, DHTTYPE);

// Definições do sensor de umidade do solo
const int pinoUmidadeSolo = 34; // GPIO 34, um pino ADC do ESP32
const int valorMinimoSoloSeco = 4095;   // Valor bruto mínimo Solo úmido (0% água)
const int valorMaximoSensorUmido = 1500; // Valor bruto máximo Solo seco     (100% água)
const int limiteUmidadeSoloBaixa = 2400; // Valor para umidade baixa    
const int limiteUmidadeSoloAlta = 2200;  // Valor para umidade alta

// Definições do relé e bomba d'água
const int pinoRele = 2; // GPIO 2
const unsigned long tempoBombaLigada = 2000; // 2 segundos

// Definições do display OLED
#define SCREEN_WIDTH 128
#define SCREEN_HEIGHT 64
#define SCREEN_ADDRESS 0x3C
Adafruit_SSD1306 oled(SCREEN_WIDTH, SCREEN_HEIGHT, &Wire);

// Bitmaps das emoções
const unsigned char emocaofeliz[] PROGMEM = {
  0x00, 0x00, 0x00, 0x00, 0x00, 0x00, 0x00, 0x00, 0x00, 0x00, 0x00, 0x00, 0x00, 0x00, 0x00, 0x00, 
  0x00, 0x00, 0x00, 0x00, 0x00, 0x00, 0x00, 0x00, 0x00, 0x00, 0x00, 0x00, 0x00, 0x00, 0x00, 0x00, 
  0x00, 0x00, 0x00, 0x00, 0x00, 0x00, 0x00, 0x00, 0x00, 0x00, 0x00, 0x00, 0x00, 0x00, 0x00, 0x00, 
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  0x00, 0x00, 0x00, 0x00, 0x00, 0x00, 0x00, 0x00, 0x00, 0x00, 0x00, 0x00, 0x00, 0x00, 0x00, 0x00
};
const unsigned char emocaotriste[] PROGMEM = {
  0x00, 0x00, 0x00, 0x00, 0x00, 0x00, 0x00, 0x00, 0x00, 0x00, 0x00, 0x00, 0x00, 0x00, 0x00, 0x00, 
  0x00, 0x00, 0x00, 0x00, 0x00, 0x00, 0x00, 0x00, 0x00, 0x00, 0x00, 0x00, 0x00, 0x00, 0x00, 0x00, 
  0x00, 0x00, 0x00, 0x00, 0x00, 0x00, 0x00, 0x00, 0x00, 0x00, 0x00, 0x00, 0x00, 0x00, 0x00, 0x00, 
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  0x00, 0x00, 0x00, 0x00, 0x00, 0x00, 0x00, 0x00, 0x00, 0x00, 0x00, 0x00, 0x00, 0x00, 0x00, 0x00
};
const unsigned char emocaosorriso[] PROGMEM = {
  0x00, 0x00, 0x00, 0x00, 0x00, 0x00, 0x00, 0x00, 0x00, 0x00, 0x00, 0x00, 0x00, 0x00, 0x00, 0x00, 
  0x00, 0x00, 0x00, 0x00, 0x00, 0x00, 0x00, 0x00, 0x00, 0x00, 0x00, 0x00, 0x00, 0x00, 0x00, 0x00, 
  0x00, 0x00, 0x00, 0x00, 0x00, 0x00, 0x00, 0x00, 0x00, 0x00, 0x00, 0x00, 0x00, 0x00, 0x00, 0x00, 
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  0x00, 0x00, 0x00, 0x00, 0x00, 0x00, 0x00, 0x00, 0x00, 0x00, 0x00, 0x00, 0x00, 0x00, 0x00, 0x00
};
const unsigned char emocaoinsatisfeita[] PROGMEM = {
  0x00, 0x00, 0x00, 0x00, 0x00, 0x00, 0x00, 0x00, 0x00, 0x00, 0x00, 0x00, 0x00, 0x00, 0x00, 0x00, 
  0x00, 0x00, 0x00, 0x00, 0x00, 0x00, 0x00, 0x00, 0x00, 0x00, 0x00, 0x00, 0x00, 0x00, 0x00, 0x00, 
  0x00, 0x00, 0x00, 0x00, 0x00, 0x00, 0x00, 0x00, 0x00, 0x00, 0x00, 0x00, 0x00, 0x00, 0x00, 0x00, 
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  0x00, 0x00, 0x00, 0x00, 0x00, 0x00, 0x00, 0x00, 0x00, 0x00, 0x00, 0x00, 0x00, 0x00, 0x00, 0x00
};


// Variáveis de contador
int contadorRele = 0;      // Contador para ativar o relé após 5 leituras de umidade baixa
int contadorDisplay = 0;   // Contador para atualizar o display após 10 leituras de umidade baixa
int contadorMensagem = 0;  // Contador para alternar as mensagens no display
int contadorUmidadeAlta = 0; // Contador para umidade excessiva

// Definição do pino do LED
const int pinoLED = 4; // GPIO 4 (D4)

void setup() {
  // Inicializa a comunicação serial
  Serial.begin(115200);

  // Conecta ao Wi-Fi
  WiFi.begin(ssid, password);
  while (WiFi.status() != WL_CONNECTED) {
    delay(1000);
    Serial.println("Conectando ao Wi-Fi...");
  }
  Serial.println("Conectado ao Wi-Fi!");

  // Inicializa o sensor DHT11
  dht.begin();

  // Configura os pinos
  pinMode(pinoRele, OUTPUT);
  digitalWrite(pinoRele, LOW); // Inicializa o relé desligado
  pinMode(pinoLED, OUTPUT);    // Configura o pino do LED como saída
  digitalWrite(pinoLED, LOW);  // Inicializa o LED desligado

  // Inicializa o display OLED
  if (!oled.begin(SSD1306_PAGEADDR, SCREEN_ADDRESS)) {
    Serial.println(F("Falha ao inicializar o display OLED"));
    for (;;);
  }
  oled.clearDisplay();
  oled.display();
}

void loop() {
  // Delimitador no Serial Monitor
  Serial.println("_________________________");

  // Lê o valor analógico do sensor capacitivo de umidade do solo
  int valorUmidadeSolo = analogRead(pinoUmidadeSolo);
  float umidadeSoloPorcentagem = map(valorUmidadeSolo, valorMaximoSensorUmido, valorMinimoSoloSeco, 100, 0); // Converte para porcentagem

  // Imprime o valor lido do sensor no monitor serial
  Serial.print("Umidade do Solo (Valor Bruto): ");
  Serial.println(valorUmidadeSolo);
  Serial.print("Umidade do Solo (%): ");
  Serial.println(umidadeSoloPorcentagem);

  // Exibe os contadores no Serial Monitor
  Serial.print("ContadorRelé: ");
  Serial.print(contadorRele);
  Serial.print("  ContadorDisplay: ");
  Serial.print(contadorDisplay);
  Serial.print("  ContadorUmidadeAlta: ");
  Serial.println(contadorUmidadeAlta);

  // Verifica a umidade do solo
  if (valorUmidadeSolo > limiteUmidadeSoloBaixa) {
    // Umidade baixa: incrementa os contadores
    contadorRele++;
    contadorDisplay++;

    // Verifica se o relé deve ser ativado
    if (contadorRele >= 5) {
      Serial.println("Umidade baixa por 5 leituras! Ligando a bomba de água...");
      digitalWrite(pinoRele, HIGH);  // Liga a bomba
      delay(tempoBombaLigada);       // Mantém a bomba ligada por 2 segundos
      digitalWrite(pinoRele, LOW);   // Desliga a bomba
      contadorRele = 0;              // Reinicia o contador do relé

      // Envia o momento de ativação da bomba para o ThingSpeak (field4)
      enviarAtivacaoBomba();
    }

    // Verifica se o display deve ser atualizado para "Triste" ou mensagem de erro
    if (contadorDisplay >= 10) {
      Serial.println("Umidade baixa por 10 leituras! Atualizando display para 'Triste'.");
      oled.clearDisplay();
      
      // Exibe a mensagem "Irrig. Comprometida" na parte superior
      oled.setCursor(10, 0);   // Posição para exibir a mensagem (x=10, y=0)
      oled.setTextSize(1);
      oled.setTextColor(WHITE);
      oled.println("Irrig. comprometida");

      // Exibe a emoção "Triste" abaixo da mensagem
      oled.drawBitmap(
        (SCREEN_WIDTH - 64) / 2, // Centraliza horizontalmente
        6,                     // Início vertical (abaixo da mensagem)
        emocaotriste,
        64, 64,                 // Largura e altura da imagem
        WHITE                   // Cor do bitmap
      );
      oled.display();

      // Liga o LED como aviso
      digitalWrite(pinoLED, HIGH);

      contadorDisplay = 0;      // Reinicia o contador do display
      
    } //!!!!!!!!!!!!!!!!!!!!!!!!!!!!!!!!!!!!!!!!!!!!!!!!!!!!!!!!!!!!!!!!!!!!!!!!!!!!!!!!!!!!!!!!!!!!!!!!!!!!!!!!!!!!!!!
  } else if (valorUmidadeSolo < limiteUmidadeSoloAlta) {
    // Umidade excessiva: incrementa o contador
    contadorUmidadeAlta++;
      //!!!!!!!!!!!!!!!!!!!!!!!!!!!!!!!!!!!!!!!!!!!!!!!!!!!!!!!!!!!!!!!!!!!!!!!!!!!!!!!!!!!!!!!!!!!!!!!!!!!!!!!!!!!!!!!
  
    // Verifica se o display deve ser atualizado para "Preciso de sol"
    if (contadorUmidadeAlta >= 18) {
      Serial.println("Umidade excessiva por 5 leituras! Atualizando display para 'Preciso de sol'.");
      oled.clearDisplay();
      
      // Exibe a mensagem "Preciso de sol" na parte superior
      oled.setCursor(10, 0);   // Posição para exibir a mensagem (x=10, y=0)
      oled.setTextSize(1);
      oled.setTextColor(WHITE);
      oled.println("Preciso de sol");

      // Exibe a emoção "Insatisfeita" abaixo da mensagem
      oled.drawBitmap(
        (SCREEN_WIDTH - 64) / 2, // Centraliza horizontalmente
        6,                     // Início vertical (abaixo da mensagem)
        emocaoinsatisfeita,
        64, 64,                 // Largura e altura da imagem
        WHITE                   // Cor do bitmap
      );
      oled.display();

      // Liga o LED como aviso
      digitalWrite(pinoLED, HIGH);

      contadorUmidadeAlta = 0;  // Reinicia o contador de umidade alta
    }
  } else {
    // Umidade adequada: reinicia os contadores
    contadorRele = 0;
    contadorDisplay = 0;
    contadorUmidadeAlta = 0;

    // Desliga o LED
    digitalWrite(pinoLED, LOW);

    // Incrementa o contador de mensagens
    contadorMensagem++;

    // Atualiza o display para "Feliz" ou "Sorriso" com mensagem alternada
    oled.clearDisplay();

    // Exibe a mensagem alternada na parte superior
    oled.setCursor(10, 0);   // Posição para exibir a mensagem (x=10, y=0)
    oled.setTextSize(1);
    oled.setTextColor(WHITE);
    if (contadorMensagem % 2 == 0) {
      oled.println("Ola!");
      // Exibe a emoção "Sorriso"
      oled.drawBitmap(
        (SCREEN_WIDTH - 64) / 2, // Centraliza horizontalmente
        6,                     // Início vertical (abaixo da mensagem)
        emocaosorriso,
        64, 56,                 // Largura e altura da imagem
        WHITE                   // Cor do bitmap
      );
    } else {
      oled.println("Tudo bem por aqui!");
      // Exibe a emoção "Feliz"
      oled.drawBitmap(
        (SCREEN_WIDTH - 64) / 2, // Centraliza horizontalmente
        6,                     // Início vertical (abaixo da mensagem)
        emocaofeliz,
        64, 56,                 // Largura e altura da imagem
        WHITE                   // Cor do bitmap
      );
    }
    oled.display();
  }

  // Lê a umidade e a temperatura do DHT11
  float umidadeAr = dht.readHumidity();
  float temperaturaAr = dht.readTemperature();

  if (isnan(umidadeAr) || isnan(temperaturaAr)) {
    Serial.println("Falha ao ler do sensor DHT11!");
  } else {
    Serial.print("Umidade do Ar: ");
    Serial.print(umidadeAr);
    Serial.print(" %\t");
    Serial.print("Temperatura: ");
    Serial.print(temperaturaAr);
    Serial.println(" °C");
  }

  // Envia os dados ao ThingSpeak
  if (WiFi.status() == WL_CONNECTED) {
    HTTPClient http;
    String url = String(server) + "/update?api_key=" + writeAPIKey +
                  "&field1=" + String(umidadeAr) +
                  "&field2=" + String(temperaturaAr) +
                  "&field3=" + String(umidadeSoloPorcentagem); // Envia a umidade em %

    http.begin(url);
    int httpCode = http.GET();  // Faz a requisição GET

    if (httpCode > 0) {
      Serial.printf("Código HTTP: %d\n", httpCode);
    } else {
      Serial.printf("Erro ao enviar dados: %s\n", http.errorToString(httpCode).c_str());
    }
    http.end();  // Finaliza a conexão HTTP
  } else {
    Serial.println("Wi-Fi desconectado!");
  }

  delay(10800000); // Aguarda 5 segundos antes de repetir o loop
}

// Função para enviar o momento de ativação da bomba para o ThingSpeak
void enviarAtivacaoBomba() {
  if (WiFi.status() == WL_CONNECTED) {
    HTTPClient http;
    String url = String(server) + "/update?api_key=" + writeAPIKey +
                  "&field4=1"; // Envia "1" para o field4 indicando ativação da bomba

    http.begin(url);
    int httpCode = http.GET();  // Faz a requisição GET

    if (httpCode > 0) {
      Serial.printf("Ativação da bomba registrada no ThingSpeak. Código HTTP: %d\n", httpCode);
    } else {
      Serial.printf("Erro ao enviar dados: %s\n", http.errorToString(httpCode).c_str());
    }
    http.end();  // Finaliza a conexão HTTP
  } else {
    Serial.println("Wi-Fi desconectado! Não foi possível registrar a ativação da bomba.");
  }
}
